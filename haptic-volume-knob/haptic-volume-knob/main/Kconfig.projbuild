## haptic-volume-knob/haptic-volume-knob/main/Kconfig.projbuild
```kconfig
menu "Example Configuration"
	config TINYUSB_ENABLED
		bool "Enable TINYUSB Arduino"
		default "y"
	config TINYUSB_HID_ENABLED
		bool "Enable TINYUSB HID"
		default "y"
	config TINYUSB_DESC_HID_STRING
		string "DESC STRING"
		default "Espressif HID Device"
	config TINYUSB_HID_BUFSIZE
		int "Buffer Size"
		default 64
endmenu
```
